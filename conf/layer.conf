## conf/layer.conf
```bitbake
#
# Copyright (C) 2021 Wind River Systems, Inc.
#

# We have a conf and classes directory, add to BBPATH
BBPATH =. "${LAYERDIR}:"

# We have recipes-* directories, add to BBFILES
BBFILES += " \
    ${LAYERDIR}/recipes-*/*/*.bb \
    ${LAYERDIR}/recipes-*/*/*.bbappend"

BBFILE_COLLECTIONS += "wr-deprecated"
BBFILE_PATTERN_wr-deprecated = "^${LAYERDIR}/"
BBFILE_PRIORITY_wr-deprecated = "6"

LAYERDEPENDS_wr-deprecated = "core"

# This should only be incremented on significant changes that will
# cause compatibility issues with other layers
LAYERVERSION_wr-deprecated = "1"

LAYERSERIES_COMPAT_wr-deprecated = "wrl hardknott"

LAYERRECOMMENDS_wr-deprecated  = "wr-deprecated-dl"

LAYER_PATH_wr-deprecated = "${LAYERDIR}"
```
